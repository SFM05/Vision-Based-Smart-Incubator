## main/Kconfig.projbuild
```kconfig
menu "IOT Configuration"
    config IOT_MQTT_SERVER
        string "Address of MQTT Server"

    config IOT_MQTT_USERNAME
        string "MQTT server Username"

    config IOT_MQTT_PASSWORD
        string "MQTT server Password"
endmenu

menu "SD Card"
    choice SD_CARD_MOD
        prompt "Method to connect SD card"
        default SD_CARD_SPI_MOD

        config SD_CARD_SPI_MOD
            bool "SPI"
        
        config SD_CARD_SDIO_MOD
            bool "SDIO(Invalid)"
    endchoice
endmenu
```
